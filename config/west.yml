## config/west.yml
```yaml
manifest:
  defaults:
    revision: main # Pin everything to v0.3
  remotes:
    - name: zmkfirmware
      url-base: https://github.com/zmkfirmware
    - name: urob
      url-base: https://github.com/urob
  projects:
    - name: zmk
      remote: zmkfirmware
      #revision: main
      import: app/west.yml
    - name: zmk-helpers
      remote: urob
      #revision: main
    - name: zmk-adaptive-key
      remote: urob
      #revision: main # set to same as ZMK version above
  self:
    path: config
```
